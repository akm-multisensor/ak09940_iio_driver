## Documentation/devicetree/bindings/iio/magnetometer/ak09940.txt
```
* AsahiKASEI AK09940 magnetometer sensor

Required properties:

  - compatible : should be "asahi-kasei,ak09940"
  - reg : the I2C address of the magnetometer

Optional properties:

  - gpios : should be device tree identifier of the magnetometer DRDY pin
  - vdd-supply: an optional regulator that needs to be on to provide VDD
  - mount-matrix: an optional 3x3 mounting rotation matrix

Example:

ak09940@0c {
        compatible = "asahi-kasei,ak09940";
        reg = <0x0c>;
        gpios = <&gpj0 7 0>;
        vdd-supply = <&ldo_3v3_gnss>;

};
```
